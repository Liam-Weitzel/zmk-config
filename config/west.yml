## config/west.yml
```yaml
manifest:
    remotes:
        - name: zmkfirmware
          url-base: https://github.com/zmkfirmware
        - name: Liam-Weitzel
          url-base: https://github.com/Liam-Weitzel
    projects:
        - name: zmk
          remote: zmkfirmware
          revision: v0.3
          import: app/west.yml
        - name: nice-shield-roshela
          remote: Liam-Weitzel
          revision: main
    self:
        path: config
```
